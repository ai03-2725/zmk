/*
 * Copyright (c) 2024 ai03 Design Studio
 *
 * SPDX-License-Identifier: MIT
 */

/dts-v1/;

#include "sentinel.dtsi"

&kscan0 {
    row-gpios
        = <&gpio1 3 (GPIO_ACTIVE_HIGH | GPIO_PULL_DOWN)>
        , <&gpio1 5 (GPIO_ACTIVE_HIGH | GPIO_PULL_DOWN)>
        , <&gpio1 7 (GPIO_ACTIVE_HIGH | GPIO_PULL_DOWN)>
        , <&gpio1 6 (GPIO_ACTIVE_HIGH | GPIO_PULL_DOWN)>
        ;
    col-gpios
        = <&gpio0 26 GPIO_ACTIVE_HIGH>
        , <&gpio0 5  GPIO_ACTIVE_HIGH>
        , <&gpio0 7  GPIO_ACTIVE_HIGH>
        , <&gpio0 28 GPIO_ACTIVE_HIGH>
        , <&gpio0 30 GPIO_ACTIVE_HIGH>
        , <&gpio0 31 GPIO_ACTIVE_HIGH>
        , <&gpio0 29 GPIO_ACTIVE_HIGH>
        ;
};